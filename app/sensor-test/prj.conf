## CMakeLists.txt
```
# SPDX-License-Identifier: Apache-2.0
cmake_minimum_required(VERSION 3.20.0)

# Pull in the shared shell/log Kconfig before find_package(Zephyr).
list(APPEND EXTRA_CONF_FILE "${CMAKE_CURRENT_LIST_DIR}/../../conf/shell-common.conf")

find_package(Zephyr REQUIRED HINTS $ENV{ZEPHYR_BASE})
project(sensor_test)

target_sources(app PRIVATE
    src/main.c
    src/tilt.c
    src/env.c
    src/mag.c
)
```

## sample.yaml
```
sample:
  name: Phial sensor test
  description: LIS2DH12 tilt drives the 16 LEDs; exercises Zephyr sensor + shell.

common:
  build_only: true
  tags:
    - phial
    - sensor
    - accel

tests:
  sample.phial.sensor_test:
    platform_allow:
      - nrf54l15dk/nrf54l15/cpuapp
    integration_platforms:
      - nrf54l15dk/nrf54l15/cpuapp
```

## prj.conf
```kconfig
# LED API + GPIO backend
CONFIG_LED=y
CONFIG_LED_GPIO=y
CONFIG_GPIO=y

# Sensor bus + LIS2DH12
CONFIG_I2C=y
CONFIG_SENSOR=y
CONFIG_LIS2DH=y

# BME280 temp/humidity/pressure: no explicit enable needed — with CONFIG_SENSOR
# on, the driver auto-enables from the bme280@76 node in phial-common.dtsi
# (CONFIG_BME280 is `default y` under `depends on DT_HAS_BOSCH_BME280_ENABLED`).

# Float angle math + printing it in the shell
CONFIG_FPU=y
CONFIG_CBPRINTF_FP_SUPPORT=y

CONFIG_MAIN_STACK_SIZE=2048

# Bringup diagnostic: Segger RTT as console + shell, mirrors led-test.
# RTT runs over SWD so it works even if UART pinctrl is wrong for this board.
# shell-common.conf enables CONFIG_SHELL_BACKEND_SERIAL; its shell log backend
# carries UART logs (no separate CONFIG_LOG_BACKEND_UART, or logs would double).
# Do NOT also enable CONFIG_LOG_BACKEND_RTT — it would fight the shell over RTT channel 0.
CONFIG_USE_SEGGER_RTT=y
CONFIG_RTT_CONSOLE=y
CONFIG_SHELL_BACKEND_RTT=y
CONFIG_UART_CONSOLE=y
```

## boards/nrf54l15dk_nrf54l15_cpuapp.overlay
```dts
/*
 * Per-app overlay wrapper: pull in the shared Phial hardware description
 * (LED map, i2c30, lis2dh12). Add app-specific tweaks below the include.
 */

#include "../../../boards/phial-common.dtsi"
```

## src/main.c
```c
/* SPDX-License-Identifier: Apache-2.0 */

#include <zephyr/kernel.h>
#include <zephyr/device.h>
#include <zephyr/drivers/led.h>
#include <zephyr/drivers/sensor.h>
#include <zephyr/logging/log.h>
#include <zephyr/shell/shell.h>
#include <stdlib.h>
#include <math.h>

#include "tilt.h"
#include "env.h"
#include "mag.h"

LOG_MODULE_REGISTER(main, LOG_LEVEL_INF);

#define NUM_LEDS   16
#define SAMPLE_MS  20        /* ~50 Hz */

/* Coarse: compass sector (0=N, CW) -> 0-based outer LED index. Sector n is at
 * n-o'clock: 0/N->LED12(11), 3/E->LED03(2), 6/S->LED06(5), 9/W->LED09(8). */
static const uint8_t sector_to_led[12] = {
    11, 0, 1, 2, 3, 4, 5, 6, 7, 8, 9, 10,
};

/* Fine: cardinal quadrant (0=N,1=E,2=S,3=W) -> inner LED index.
 * LED13 N(12), LED14 E(13), LED15 S(14), LED16 W(15). Verify on hardware. */
static const uint8_t quadrant_to_led[4] = { 12, 13, 14, 15 };

/* Magnet-present LED pattern: two quick pulses then a pause (~1 Hz), visually
 * distinct from the solid "level" state. {LEDs on?, hold duration ms}. */
static const struct { bool on; int32_t ms; } mag_blink[] = {
    { true, 80 }, { false, 80 }, { true, 80 }, { false, 760 },
};
#define MAG_BLINK_STEPS  ((int)ARRAY_SIZE(mag_blink))

/* Shared so the `tilt` shell command can read/tune live. */
static struct tilt_state g_state = TILT_STATE_INIT;
static float g_alpha = 0.5f;         /* EMA smoothing (higher = snappier) */
static float g_ax, g_ay, g_az;       /* filtered, m/s^2 */
static struct tilt_out g_target = { .mode = TILT_MODE_LEVEL, .sector = -1 };

static void render(const struct device *leds, struct tilt_out t)
{
    for (int i = 0; i < NUM_LEDS; i++) {
        led_off(leds, i);
    }
    switch (t.mode) {
    case TILT_MODE_LEVEL:
        for (int i = 0; i < NUM_LEDS; i++) {
            led_on(leds, i);          /* level achieved: whole board solid */
        }
        break;
    case TILT_MODE_FINE:
        led_on(leds, quadrant_to_led[t.sector]);
        break;
    case TILT_MODE_COARSE:
        led_on(leds, sector_to_led[t.sector]);
        break;
    }
}

int main(void)
{
    const struct device *leds  = DEVICE_DT_GET_ANY(gpio_leds);
    const struct device *accel = DEVICE_DT_GET(DT_NODELABEL(accel));

    if (leds == NULL || !device_is_ready(leds)) {
        LOG_ERR("LED device not ready");
        return -ENODEV;
    }
    if (!device_is_ready(accel)) {
        LOG_ERR("Accelerometer (lis2dh12) not ready");
        return -ENODEV;
    }

    if (env_init() != 0) {
        LOG_WRN("env sampling disabled (BME280 unavailable)");
    }

    if (mag_init() != 0) {
        LOG_WRN("magnet sensor disabled (LF21115TMR GPIO unavailable)");
    }

    LOG_INF("Phial sensor-test: zoom level (%d Hz)", 1000 / SAMPLE_MS);

    render(leds, g_target);   /* start at LEVEL (all on) until first sample */

    bool in_magnet_mode = false;   /* magnet override is currently driving the LEDs */
    int blink_step = 0;            /* index into mag_blink[] (re-init on entry) */
    int64_t step_start_ms = 0;     /* uptime when the current blink step began */

    while (1) {
        struct sensor_value v[3];
        struct tilt_out t = g_target;   /* keep last target if a fetch fails */

        if (sensor_sample_fetch(accel) == 0 &&
            sensor_channel_get(accel, SENSOR_CHAN_ACCEL_XYZ, v) == 0) {
            float ax = (float)sensor_value_to_double(&v[0]);
            float ay = (float)sensor_value_to_double(&v[1]);
            float az = (float)sensor_value_to_double(&v[2]);

            /* EMA low-pass to kill jitter. Keep sampling even in magnet mode so
             * the tilt target is current the instant the magnet leaves. */
            g_ax += g_alpha * (ax - g_ax);
            g_ay += g_alpha * (ay - g_ay);
            g_az += g_alpha * (az - g_az);

            t = tilt_update(&g_state, g_ax, g_ay);
        }

        if (mag_present()) {
            /* Magnet overrides the display: two quick pulses then a pause (~1 Hz),
             * visually distinct from the solid "level" state. */
            int64_t now = k_uptime_get();

            if (!in_magnet_mode) {
                in_magnet_mode = true;
                blink_step = MAG_BLINK_STEPS - 1;            /* advance below wraps to step 0 */
                step_start_ms = now - mag_blink[blink_step].ms;  /* due now: first pulse immediately */
            }
            if (now - step_start_ms >= mag_blink[blink_step].ms) {
                blink_step = (blink_step + 1) % MAG_BLINK_STEPS;
                step_start_ms = now;
                for (int i = 0; i < NUM_LEDS; i++) {
                    if (mag_blink[blink_step].on) {
                        led_on(leds, i);
                    } else {
                        led_off(leds, i);
                    }
                }
                if (blink_step == 0) {
                    LOG_INF("magnet: flash");   /* once per double-blink cycle */
                }
            }
        } else if (in_magnet_mode) {
            /* Magnet just removed: leave blink mode, restore the tilt display. */
            in_magnet_mode = false;
            g_target = t;
            render(leds, t);
        } else if (t.mode != g_target.mode || t.sector != g_target.sector) {
            g_target = t;
            render(leds, t);
        }

        k_msleep(SAMPLE_MS);
    }
    return 0;
}

/* ---- tilt shell command: live status + tuning ------------------------- */

static int cmd_tilt_status(const struct shell *sh, size_t argc, char **argv)
{
    ARG_UNUSED(argc); ARG_UNUSED(argv);
    struct tilt_out t = g_target;
    float mag = hypotf(g_ax, g_ay);

    shell_print(sh, "accel (filt): x=%.3f y=%.3f z=%.3f  |xy|=%.3f m/s^2",
                (double)g_ax, (double)g_ay, (double)g_az, (double)mag);
    shell_print(sh, "offset=%.1f deg  alpha=%.2f  coarse>=%.2f  level<%.2f  hyst=%.2f",
                (double)g_state.cal.offset_deg, (double)g_alpha,
                (double)g_state.cal.coarse_ms2, (double)g_state.cal.level_ms2,
                (double)g_state.cal.zone_hyst_ms2);

    switch (t.mode) {
    case TILT_MODE_LEVEL:
        shell_print(sh, "mode: LEVEL (all 16 on)");
        break;
    case TILT_MODE_FINE:
        shell_print(sh, "mode: FINE  quadrant %d -> LED%02d (inner)",
                    t.sector, quadrant_to_led[t.sector] + 1);
        break;
    case TILT_MODE_COARSE:
        shell_print(sh, "mode: COARSE sector %d -> LED%02d (outer)",
                    t.sector, sector_to_led[t.sector] + 1);
        break;
    }
    return 0;
}

static int cmd_tilt_offset(const struct shell *sh, size_t argc, char **argv)
{
    if (argc != 2) {
        shell_error(sh, "usage: tilt offset <deg>");
        return -EINVAL;
    }
    g_state.cal.offset_deg = strtof(argv[1], NULL);
    shell_print(sh, "offset = %.1f deg (volatile)", (double)g_state.cal.offset_deg);
    return 0;
}

static int cmd_tilt_coarse(const struct shell *sh, size_t argc, char **argv)
{
    if (argc != 2) {
        shell_error(sh, "usage: tilt coarse <m/s^2>");
        return -EINVAL;
    }
    g_state.cal.coarse_ms2 = strtof(argv[1], NULL);
    shell_print(sh, "coarse threshold = %.2f m/s^2", (double)g_state.cal.coarse_ms2);
    return 0;
}

static int cmd_tilt_level(const struct shell *sh, size_t argc, char **argv)
{
    if (argc != 2) {
        shell_error(sh, "usage: tilt level <m/s^2>");
        return -EINVAL;
    }
    g_state.cal.level_ms2 = strtof(argv[1], NULL);
    shell_print(sh, "level threshold = %.2f m/s^2", (double)g_state.cal.level_ms2);
    return 0;
}

static int cmd_tilt_alpha(const struct shell *sh, size_t argc, char **argv)
{
    if (argc != 2) {
        shell_error(sh, "usage: tilt alpha <0..1>");
        return -EINVAL;
    }
    g_alpha = strtof(argv[1], NULL);
    shell_print(sh, "EMA alpha = %.2f", (double)g_alpha);
    return 0;
}

SHELL_STATIC_SUBCMD_SET_CREATE(tilt_sub,
    SHELL_CMD(status, NULL, "Show filtered accel, magnitude, zone config, target.",
              cmd_tilt_status),
    SHELL_CMD_ARG(offset, NULL, "Set angle offset in degrees (volatile).",
                  cmd_tilt_offset, 2, 0),
    SHELL_CMD_ARG(coarse, NULL, "Set COARSE zone threshold, m/s^2 (volatile).",
                  cmd_tilt_coarse, 2, 0),
    SHELL_CMD_ARG(level, NULL, "Set LEVEL zone threshold, m/s^2 (volatile).",
                  cmd_tilt_level, 2, 0),
    SHELL_CMD_ARG(alpha, NULL, "Set EMA smoothing 0..1, higher=snappier (volatile).",
                  cmd_tilt_alpha, 2, 0),
    SHELL_SUBCMD_SET_END);

SHELL_CMD_REGISTER(tilt, &tilt_sub, "Phial tilt/level tuning", NULL);
```

## src/env.c
```c
/* SPDX-License-Identifier: Apache-2.0 */

#include <zephyr/kernel.h>
#include <zephyr/device.h>
#include <zephyr/drivers/sensor.h>
#include <zephyr/logging/log.h>
#include <zephyr/shell/shell.h>
#include <errno.h>

#include "env.h"

LOG_MODULE_REGISTER(env, LOG_LEVEL_INF);

#define ENV_SAMPLE_MS      10000
#define ENV_THREAD_STACK   1024
#define ENV_THREAD_PRIO    7

static const struct device *const bme = DEVICE_DT_GET(DT_NODELABEL(bme280));

static struct env_reading g_reading;     /* guarded by g_lock */
K_MUTEX_DEFINE(g_lock);

static void env_thread(void *p1, void *p2, void *p3);

/* SYS_FOREVER_MS start delay: the thread is NOT auto-started at boot
 * (K_THREAD_DEFINE's delay arg is a millisecond count; SYS_FOREVER_MS is the
 * sentinel for "never"). env_init() starts it only after the device-ready
 * check passes. */
K_THREAD_DEFINE(env_tid, ENV_THREAD_STACK, env_thread, NULL, NULL, NULL,
                ENV_THREAD_PRIO, 0, SYS_FOREVER_MS);

bool env_get(struct env_reading *out)
{
    bool valid;

    k_mutex_lock(&g_lock, K_FOREVER);
    *out = g_reading;
    valid = g_reading.valid;
    k_mutex_unlock(&g_lock);
    return valid;
}

static void env_thread(void *p1, void *p2, void *p3)
{
    ARG_UNUSED(p1); ARG_UNUSED(p2); ARG_UNUSED(p3);

    while (1) {
        struct sensor_value t, h, p;

        if (sensor_sample_fetch(bme) == 0 &&
            sensor_channel_get(bme, SENSOR_CHAN_AMBIENT_TEMP, &t) == 0 &&
            sensor_channel_get(bme, SENSOR_CHAN_HUMIDITY, &h) == 0 &&
            sensor_channel_get(bme, SENSOR_CHAN_PRESS, &p) == 0) {

            float temp = (float)sensor_value_to_double(&t);
            float hum  = (float)sensor_value_to_double(&h);
            float pres = (float)sensor_value_to_double(&p);

            k_mutex_lock(&g_lock, K_FOREVER);
            g_reading.temp_c       = temp;
            g_reading.humidity_pct = hum;
            g_reading.pressure_kpa = pres;
            g_reading.uptime_ms    = k_uptime_get();
            g_reading.valid        = true;
            k_mutex_unlock(&g_lock);

            LOG_INF("T=%.2f C  RH=%.2f %%  P=%.2f kPa",
                    (double)temp, (double)hum, (double)pres);
        } else {
            LOG_WRN("BME280 fetch failed");
        }

        k_msleep(ENV_SAMPLE_MS);
    }
}

int env_init(void)
{
    static bool started;

    if (started) {
        return 0;
    }
    if (!device_is_ready(bme)) {
        LOG_ERR("BME280 not ready");
        return -ENODEV;
    }
    k_thread_start(env_tid);
    started = true;
    return 0;
}

/* ---- env shell command: print the latest cached reading ---------------- */

static int cmd_env(const struct shell *sh, size_t argc, char **argv)
{
    ARG_UNUSED(argc); ARG_UNUSED(argv);
    struct env_reading r;

    if (!env_get(&r)) {
        shell_print(sh, "no sample yet");
        return 0;
    }
    shell_print(sh, "env: T=%.2f C  RH=%.2f %%  P=%.2f kPa  (age %lld ms)",
                (double)r.temp_c, (double)r.humidity_pct, (double)r.pressure_kpa,
                (long long)(k_uptime_get() - r.uptime_ms));
    return 0;
}

SHELL_CMD_REGISTER(env, NULL, "Show latest BME280 environmental reading", cmd_env);
```

## src/env.h
```c
/* SPDX-License-Identifier: Apache-2.0 */
#ifndef PHIAL_ENV_H_
#define PHIAL_ENV_H_

#include <stdbool.h>
#include <stdint.h>

/* Latest BME280 environmental reading. Units match what the Zephyr BME280
 * driver reports: temperature in °C, humidity in %RH, pressure in kPa. */
struct env_reading {
    float   temp_c;
    float   humidity_pct;
    float   pressure_kpa;
    int64_t uptime_ms;   /* k_uptime_get() when this sample was taken */
    bool    valid;       /* false until the first successful sample */
};

/* Verify the BME280 is ready and start the 10 s sampling thread.
 * Returns 0 on success, -ENODEV if the device is not ready (thread NOT
 * started, so a missing sensor produces no recurring warnings). */
int env_init(void);

/* Copy the latest cached reading into *out under the module mutex.
 * Returns true if a valid sample exists, false otherwise. This is the seam a
 * future BLE/Golioth transport reads — it never touches the bus or blocks. */
bool env_get(struct env_reading *out);

#endif /* PHIAL_ENV_H_ */
```

## src/mag.c
```c
/* SPDX-License-Identifier: Apache-2.0 */

#include <zephyr/kernel.h>
#include <zephyr/drivers/gpio.h>
#include <zephyr/logging/log.h>
#include <errno.h>

#include "mag.h"

LOG_MODULE_REGISTER(mag, LOG_LEVEL_INF);

static const struct gpio_dt_spec mag = GPIO_DT_SPEC_GET(DT_PATH(zephyr_user), mag_gpios);

static bool init_ok;   /* true only after the pin is configured as input */

int mag_init(void)
{
    int rc;

    if (!gpio_is_ready_dt(&mag)) {
        LOG_ERR("magnet GPIO not ready");
        return -ENODEV;
    }

    rc = gpio_pin_configure_dt(&mag, GPIO_INPUT);
    if (rc != 0) {
        LOG_ERR("magnet GPIO configure failed (%d)", rc);
        return rc;
    }

    init_ok = true;
    return 0;
}

bool mag_present(void)
{
    /* If init failed/never ran, the pin isn't configured as an input — report
     * "not present" rather than reading an undefined direction. */
    if (!init_ok) {
        return false;
    }

    /* gpio_pin_get_dt returns the logical level (ACTIVE_LOW-corrected): 1 when a
     * magnet pulls the line low. Negative on error -> treated as "not present". */
    return gpio_pin_get_dt(&mag) == 1;
}
```

## src/mag.h
```c
/* SPDX-License-Identifier: Apache-2.0 */
#ifndef PHIAL_MAG_H_
#define PHIAL_MAG_H_

#include <stdbool.h>

/* Configure the LF21115TMR magnet-switch GPIO (P1.13) as an input.
 * Returns 0 on success, -ENODEV if the GPIO is not ready (feature disabled). */
int mag_init(void);

/* True when a magnet is present. The LF21115TMR pulls its push-pull output low
 * in a field; the DT spec is GPIO_ACTIVE_LOW, so the logical pin value is 1 then.
 * This is the seam a future BLE/Golioth transport reads. */
bool mag_present(void);

#endif /* PHIAL_MAG_H_ */
```

## src/tilt.c
```c
/* SPDX-License-Identifier: Apache-2.0 */
#include "tilt.h"
#include <math.h>

/* M_PI is POSIX, not ISO C — Zephyr's strict-C11 libc may not define it. */
#ifndef M_PI
#define M_PI 3.14159265358979323846
#endif

#define RAD_TO_DEG (180.0f / (float)M_PI)

/* Apply axis swap/invert, return in *ox,*oy. */
static void apply_axes(const struct tilt_cal *cal, float ax, float ay,
                       float *ox, float *oy)
{
    if (cal->swap_xy) {
        float t = ax; ax = ay; ay = t;
    }
    if (cal->invert_x) ax = -ax;
    if (cal->invert_y) ay = -ay;
    *ox = ax;
    *oy = ay;
}

/* Downhill bearing as a compass angle in [0,360): 0=N, increasing clockwise. */
static float downhill_compass_deg(const struct tilt_cal *cal, float ax, float ay)
{
    float cx, cy;
    apply_axes(cal, ax, ay, &cx, &cy);

    /* Downhill direction = -(in-plane reaction vector) = (-cx, -cy). */
    float math_deg = atan2f(-cy, -cx) * RAD_TO_DEG;   /* CCW from +x (East) */
    float compass = 90.0f - math_deg + cal->offset_deg;
    compass = fmodf(compass, 360.0f);
    if (compass < 0.0f) compass += 360.0f;
    return compass;
}

int tilt_sector(float ax, float ay, const struct tilt_cal *cal)
{
    float mag = hypotf(ax, ay);
    if (mag < cal->enter_ms2) {
        return TILT_LEVEL;
    }
    float compass = downhill_compass_deg(cal, ax, ay);
    int sector = (int)lroundf(compass / 30.0f);
    return ((sector % 12) + 12) % 12;
}

/* Quantize a compass bearing to one of `n` equal sectors (0 = North, CW), with
 * seam hysteresis: when `last` is a valid sector, hold it until the bearing
 * moves more than (half-sector + seam_margin) from its center. */
static int quant_hyst(float compass, int n, int last, float seam_margin)
{
    float step = 360.0f / (float)n;
    int s = (((int)lroundf(compass / step)) % n + n) % n;

    if (last >= 0 && s != last) {
        float last_center = (float)last * step;
        float d = fmodf(fabsf(compass - last_center), 360.0f);
        if (d > 180.0f) d = 360.0f - d;
        if (d <= (step / 2.0f + seam_margin)) {
            s = last;
        }
    }
    return s;
}

/* Hysteretic "is m above boundary b": needs a wider push to cross when it would
 * change state. `currently_above` is the present side of the boundary. */
static bool above(float m, float b, float h, bool currently_above)
{
    return currently_above ? (m > b - h) : (m > b + h);
}

static enum tilt_mode classify(float m, enum tilt_mode last, const struct tilt_cal *c)
{
    bool above_level  = above(m, c->level_ms2,  c->zone_hyst_ms2, last != TILT_MODE_LEVEL);
    bool above_coarse = above(m, c->coarse_ms2, c->zone_hyst_ms2, last == TILT_MODE_COARSE);

    if (above_coarse) return TILT_MODE_COARSE;
    if (above_level)  return TILT_MODE_FINE;
    return TILT_MODE_LEVEL;
}

struct tilt_out tilt_update(struct tilt_state *st, float ax, float ay)
{
    const struct tilt_cal *c = &st->cal;
    float m = hypotf(ax, ay);
    enum tilt_mode mode = classify(m, st->last_mode, c);
    struct tilt_out out = { .mode = mode, .sector = -1 };

    if (mode != TILT_MODE_LEVEL) {
        float compass = downhill_compass_deg(c, ax, ay);
        if (mode == TILT_MODE_COARSE) {
            int last = (st->last_mode == TILT_MODE_COARSE) ? st->last_sector : -1;
            out.sector = quant_hyst(compass, 12, last, c->seam_margin_deg);
            st->last_sector = out.sector;
        } else { /* FINE */
            int last = (st->last_mode == TILT_MODE_FINE) ? st->last_quadrant : -1;
            out.sector = quant_hyst(compass, 4, last, c->seam_margin_deg);
            st->last_quadrant = out.sector;
        }
    }

    st->last_mode = mode;
    return out;
}
```

## src/tilt.h
```c
/* SPDX-License-Identifier: Apache-2.0 */
#ifndef PHIAL_TILT_H_
#define PHIAL_TILT_H_

#include <stdbool.h>

/* Returned by tilt_sector when the board is within the level deadzone.
 * Otherwise it returns a compass sector 0..11 (0 = North, clockwise). */
#define TILT_LEVEL (-1)

/* Display zones for the "zoom" level, selected by in-plane tilt magnitude:
 *   COARSE — large tilt: one of 12 outer ring positions (downhill bearing)
 *   FINE   — small tilt: one of 4 inner cardinals (downhill bearing)
 *   LEVEL  — near flat: caller lights all LEDs solid */
enum tilt_mode {
    TILT_MODE_LEVEL = 0,
    TILT_MODE_FINE,
    TILT_MODE_COARSE,
};

/* Result of tilt_update(). `sector` is board-agnostic: for COARSE it is an
 * outer position 0..11 (0=N, CW); for FINE a cardinal 0..3 (0=N,1=E,2=S,3=W);
 * for LEVEL it is -1 (unused). The caller maps sector -> physical LED. */
struct tilt_out {
    enum tilt_mode mode;
    int sector;
};

/* Calibration. Defaults assume the chip's +X = board East, +Y = board North,
 * +Z = up. Real mounting rotation/mirroring is dialed in on the bench, then
 * baked into TILT_CAL_DEFAULT. Thresholds are in m/s^2 of in-plane gravity
 * (|g| ~ 9.8; enter ~2.5 ~= 15deg tilt, exit ~1.5 ~= 9deg). */
struct tilt_cal {
    float offset_deg;       /* added to the compass angle (chip-vs-ring rotation) */
    bool  swap_xy;          /* swap axes if the chip is mounted rotated 90deg */
    bool  invert_x;         /* per-axis sign flips for mirror/rotation */
    bool  invert_y;
    float enter_ms2;        /* tilt_sector deadzone: in-plane |g| to leave level */
    float exit_ms2;         /* tilt_sector deadzone return (< enter = hysteresis) */
    float seam_margin_deg;  /* extra angle past a seam before the lit sector changes */

    /* Zone thresholds for tilt_update()'s zoom level (in-plane |g|, m/s^2): */
    float coarse_ms2;       /* >= this -> COARSE (outer ring) */
    float level_ms2;        /* <  this -> LEVEL (all LEDs); between -> FINE (inner) */
    float zone_hyst_ms2;    /* hysteresis margin on both zone boundaries */
};

/* offset_deg = 270 (= -90): bench-calibrated chip-vs-ring rotation. With the
 * 12-o'clock (North) edge pointed down, the chip reads ax~=-g (its +X points
 * to ring-West); +270deg rotates the compass so downhill lights the correct LED.
 * Verified on hardware across all four cardinals. */
#define TILT_CAL_DEFAULT {            \
    .offset_deg = 270.0f,             \
    .swap_xy = false,                 \
    .invert_x = false,                \
    .invert_y = false,                \
    .enter_ms2 = 2.5f,                \
    .exit_ms2 = 1.5f,                 \
    .seam_margin_deg = 6.0f,          \
    .coarse_ms2 = 2.5f,               \
    .level_ms2 = 0.5f,                \
    .zone_hyst_ms2 = 0.3f,            \
}

struct tilt_state {
    struct tilt_cal cal;
    enum tilt_mode last_mode;
    int last_sector;    /* last COARSE outer position 0..11 (-1 = none) */
    int last_quadrant;  /* last FINE inner cardinal 0..3   (-1 = none) */
};

/* Convenience initializer for a fresh state with the default calibration. */
#define TILT_STATE_INIT {                 \
    .cal = TILT_CAL_DEFAULT,              \
    .last_mode = TILT_MODE_LEVEL,         \
    .last_sector = -1,                    \
    .last_quadrant = -1,                  \
}

/* Stateless: TILT_LEVEL if in-plane |g| < cal->enter_ms2, else compass sector
 * 0..11 (downhill direction). Used for the pure-angle unit tests. */
int tilt_sector(float ax, float ay, const struct tilt_cal *cal);

/* Stateful zoom level: classifies the tilt magnitude into LEVEL/FINE/COARSE
 * with zone hysteresis, and within FINE/COARSE quantizes the downhill bearing
 * (4 or 12 sectors) with seam hysteresis. Updates *st. */
struct tilt_out tilt_update(struct tilt_state *st, float ax, float ay);

#endif /* PHIAL_TILT_H_ */
```
