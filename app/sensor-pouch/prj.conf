## CMakeLists.txt
```
# SPDX-License-Identifier: Apache-2.0
cmake_minimum_required(VERSION 3.20.0)
find_package(Zephyr REQUIRED HINTS $ENV{ZEPHYR_BASE})
project(sensor_pouch)

target_sources(app PRIVATE
    src/main.c
    src/env.c
    src/ble_peripheral.c
    src/credentials.c
    src/fw_update.c
    src/fatal_error.c
    src/led_index.c
    src/app_settings.c
)
```

## Kconfig
```
# Copyright (c) 2025 Golioth, Inc.
#
# SPDX-License-Identifier: Apache-2.0

source "$ZEPHYR_BASE/Kconfig"

config EXAMPLE_SYNC_PERIOD_S
    int "Sync Period"
    default 20
    help
      The time, in seconds, after a sync to wait before requesting a sync from
      a gateway.

config EXAMPLE_CREDENTIALS_DIR
    string "Directory containing credentials"
    default "/lfs1/credentials"
    help
      Directory on mounted file system containing credentials.

config EXAMPLE_FW_UPDATE_COMPONENT
    string "OTA component to use for firmware update"
    default "phial_sensor_pouch"
    help
      Name of component in OTA manifest to use for firmware update.
      Must match the component name configured in the Golioth OTA release.

# This option is used only for automated tests
config EXAMPLE_BT_AUTO_CONFIRM
	bool
	default y if BOARD_NRF52_BSIM_NATIVE
```

## sample.yaml
```
sample:
  name: Phial sensor-pouch
  description: BME280 -> Golioth Stream over pouch BLE GATT; cloud LED setting (1-16) lights an LED.
common:
  build_only: true
  tags:
    - phial
    - pouch
    - bluetooth
tests:
  sample.phial.sensor_pouch:
    platform_allow:
      - nrf54l15dk/nrf54l15/cpuapp
    integration_platforms:
      - nrf54l15dk/nrf54l15/cpuapp
    extra_args:
      - --sysbuild
```

## prj.conf
```kconfig
# BLE GATT pouch transport
CONFIG_BT=y
CONFIG_BT_SMP=y
CONFIG_BT_PERIPHERAL=y
CONFIG_BT_DEVICE_NAME="Phial-Pouch"
CONFIG_BT_DEVICE_APPEARANCE=768
CONFIG_BT_BUF_ACL_TX_SIZE=251
CONFIG_BT_BUF_ACL_RX_SIZE=251
CONFIG_BT_L2CAP_TX_MTU=247
CONFIG_BT_SMP_ALLOW_UNAUTH_OVERWRITE=y
CONFIG_BT_CTLR_DATA_LENGTH_MAX=251
CONFIG_BT_RX_STACK_SIZE=4096
CONFIG_MAIN_STACK_SIZE=4096
CONFIG_MBEDTLS_HEAP_SIZE=9192
# Implied by BT_SMP but breaks pouch's secp384r1 (we use the Oberon/CRACEN path).
CONFIG_MBEDTLS_PSA_P256M_DRIVER_ENABLED=n
# Trim unused mbedTLS ROM (not needed for our cert/key type).
CONFIG_MBEDTLS_PKCS5_C=n

CONFIG_LOG=y
# Sibling apps get this from conf/shell-common.conf; set it here since this app
# deliberately does not use that file (MCUmgr owns the shell/console).
CONFIG_LOG_DEFAULT_LEVEL=3
CONFIG_ZCBOR=y
CONFIG_REBOOT=y
# Shell — inline here (not via shell-common.conf) because the MCUmgr SMP
# transport owns the shell/console path for this app.
CONFIG_SHELL=y

# pouch + golioth-over-pouch
CONFIG_POUCH=y
CONFIG_POUCH_TRANSPORT_BLE_GATT=y
CONFIG_GOLIOTH=y
CONFIG_GOLIOTH_SETTINGS=y
CONFIG_GOLIOTH_OTA=y

# Credentials filesystem
CONFIG_FLASH=y
CONFIG_FLASH_MAP=y
CONFIG_FILE_SYSTEM=y
CONFIG_FILE_SYSTEM_LITTLEFS=y
CONFIG_FILE_SYSTEM_SHELL=y

# MCUmgr (serial/SMP) for credential provisioning
CONFIG_MCUMGR=y
CONFIG_CONSOLE=y
CONFIG_UART_CONSOLE=y
CONFIG_UART_CONSOLE_MCUMGR=y
CONFIG_BASE64=y
CONFIG_CRC=y
CONFIG_MCUMGR_TRANSPORT_SHELL=y
CONFIG_MCUMGR_GRP_OS=y
CONFIG_MCUMGR_GRP_OS_MCUMGR_PARAMS=y
CONFIG_MCUMGR_GRP_FS=y
CONFIG_MCUMGR_MGMT_NOTIFICATION_HOOKS=y
CONFIG_MCUMGR_GRP_FS_FILE_ACCESS_HOOK=y

# OTA image handling
CONFIG_STREAM_FLASH=y
CONFIG_IMG_MANAGER=y
CONFIG_IMG_ERASE_PROGRESSIVELY=y

# Floating-point formatting for the %.2f sensor values:
#   PICOLIBC_IO_FLOAT  -> snprintf() (JSON uplink encode)
#   CBPRINTF_FP_SUPPORT -> shell_print()/LOG (cbprintf-based)
# Without these the temp/humidity/pressure print as garbage.
CONFIG_PICOLIBC_IO_FLOAT=y
CONFIG_CBPRINTF_FP_SUPPORT=y

# Phial hardware: BME280 + 16 LEDs
CONFIG_SENSOR=y
CONFIG_LED=y
CONFIG_LED_GPIO=y
CONFIG_GPIO=y
```

## boards/nrf54l15dk_nrf54l15_cpuapp.overlay
```dts
/*
 * sensor-pouch overlay: shared Phial hardware + MCUboot-friendly partitions.
 *
 * phial-common.dtsi shrank slot1 to 536K and added mic_clip (for mic-test).
 * MCUboot image swap needs slot0 == slot1 (both 664K), so we restore the stock
 * slot1 size and delete mic_clip (unused here). The dtsi's "no MCUboot" comment
 * predates this app and is stale for sensor-pouch.
 */
#include "../../../boards/phial-common.dtsi"

/delete-node/ &mic_clip_partition;

&slot1_partition {
    reg = <0xb6000 DT_SIZE_K(664)>;   /* 0xb6000..0x15c000, matches slot0 size */
};

/ {
    fstab {
        compatible = "zephyr,fstab";
        lfs1: lfs1 {
            compatible = "zephyr,fstab,littlefs";
            mount-point = "/lfs1";
            partition = <&storage_partition>;
            automount;
            read-size = <16>;
            prog-size = <16>;
            cache-size = <64>;
            lookahead-size = <32>;
            block-cycles = <512>;
        };
    };
};
```

## src/main.c
```c
/* SPDX-License-Identifier: Apache-2.0 */
#include <zephyr/kernel.h>
#include <zephyr/device.h>
#include <zephyr/drivers/gpio.h>
#include <zephyr/drivers/led.h>
#include <zephyr/logging/log.h>
#include <zephyr/shell/shell.h>
#include <stdio.h>
#include <string.h>

#include <pouch/pouch.h>
#include <pouch/events.h>
#include <pouch/uplink.h>
#include <pouch/transport/bluetooth/gatt.h>

#include "ble_peripheral.h"
#include "credentials.h"
#include "env.h"
#include "app_settings.h"

LOG_MODULE_REGISTER(main, LOG_LEVEL_INF);

static const struct gpio_dt_spec button =
    GPIO_DT_SPEC_GET(DT_PATH(zephyr_user), button_gpios);
static struct gpio_callback button_cb;

static const struct device *g_leds;
static atomic_t g_syncing;
/* g_last_sync: pointer to a string literal, written from the workqueue/pouch-event
 * contexts and read from the shell. Word-aligned pointer load/store is atomic on
 * this target and the value is display-only, so no lock is needed. */
static const char *g_last_sync = "none";
static struct k_work g_sync_work;

static void do_uplink(void)
{
    struct env_reading r;
    char json[96];

    if (!env_get(&r)) {
        LOG_WRN("no BME280 reading yet; skipping uplink");
        return;
    }
    int n = snprintf(json, sizeof(json),
                     "{\"temp\":%.2f,\"humidity\":%.2f,\"pressure\":%.2f}",
                     (double)r.temp_c, (double)r.humidity_pct, (double)r.pressure_kpa);
    if (n <= 0 || n >= (int)sizeof(json)) {
        LOG_ERR("uplink JSON encode failed");
        return;
    }
    int err = pouch_uplink_entry_write(".s/sensor", POUCH_CONTENT_TYPE_JSON,
                                       json, (size_t)n, POUCH_FOREVER);
    if (err) {
        LOG_ERR("uplink write failed (%d)", err);
    } else {
        LOG_INF("uplink: %s", json);
    }
}
POUCH_UPLINK_HANDLER(do_uplink);

static void on_pouch_event(enum pouch_event event, void *ctx)
{
    ARG_UNUSED(ctx);
    if (event == POUCH_EVENT_SESSION_END) {
        ble_peripheral_request_gateway(false);
        atomic_set(&g_syncing, 0);
        g_last_sync = "ok";
        LOG_INF("sync complete");
    }
}
POUCH_EVENT_HANDLER(on_pouch_event, NULL);

static void start_sync(void)
{
    if (!atomic_cas(&g_syncing, 0, 1)) {
        return;   /* a sync is already in progress */
    }
    g_last_sync = "in-progress";
    LOG_INF("sync requested");
    ble_peripheral_request_gateway(true);
}

static void sync_work_handler(struct k_work *work)
{
    ARG_UNUSED(work);
    start_sync();
}

static void button_pressed(const struct device *dev, struct gpio_callback *cb, uint32_t pins)
{
    ARG_UNUSED(dev); ARG_UNUSED(cb); ARG_UNUSED(pins);
    k_work_submit(&g_sync_work);
}

static int setup_pouch(void)
{
    struct pouch_config config = {0};
    int err = load_certificate(&config.certificate);

    if (err) {
        LOG_ERR("No certificate (%d) - provision creds over MCUmgr, then reboot", err);
        return err;
    }
    config.private_key = load_private_key();
    if (config.private_key == PSA_KEY_ID_NULL) {
        LOG_ERR("No private key - provision creds over MCUmgr, then reboot");
        return -ENOENT;
    }
    err = pouch_init(&config);
    if (err) {
        LOG_ERR("pouch_init failed (%d)", err);
    }
    return err;
}

static void setup_button(void)
{
    if (!gpio_is_ready_dt(&button) ||
        gpio_pin_configure_dt(&button, GPIO_INPUT | GPIO_PULL_UP) != 0 ||
        gpio_pin_interrupt_configure_dt(&button, GPIO_INT_EDGE_TO_ACTIVE) != 0) {
        LOG_WRN("boot button unavailable; use the gateway's own trigger");
        return;
    }
    gpio_init_callback(&button_cb, button_pressed, BIT(button.pin));
    if (gpio_add_callback(button.port, &button_cb) != 0) {
        LOG_WRN("failed to add button callback");
    }
}

int main(void)
{
    LOG_INF("Phial sensor-pouch (pouch proto v%d, gatt v%d)",
            POUCH_VERSION, POUCH_GATT_VERSION);

    int err = ble_peripheral_init();
    if (err) {
        LOG_ERR("BLE init failed (%d)", err);
        return err;
    }

    bool pouch_ok = (setup_pouch() == 0);

    g_leds = DEVICE_DT_GET_ANY(gpio_leds);
    if (g_leds != NULL && device_is_ready(g_leds)) {
        app_settings_init(g_leds);
    } else {
        LOG_WRN("LED device not ready; LED setting will be logged only");
        g_leds = NULL;
    }

    if (env_init() != 0) {
        LOG_WRN("BME280 unavailable; uplink will have no reading");
    }

    k_work_init(&g_sync_work, sync_work_handler);
    setup_button();

    err = ble_peripheral_start();
    if (err) {
        LOG_ERR("BLE advertising start failed (%d)", err);
        return err;
    }
    LOG_INF("ready%s - press the boot button to sync",
            pouch_ok ? "" : " (no creds: provision over MCUmgr + reboot)");
    return 0;
}

static int cmd_status(const struct shell *sh, size_t argc, char **argv)
{
    ARG_UNUSED(argc); ARG_UNUSED(argv);
    struct env_reading r;
    bool have = env_get(&r);

    shell_print(sh, "syncing:   %s", atomic_get(&g_syncing) ? "yes" : "no");
    shell_print(sh, "last sync: %s", g_last_sync);
    shell_print(sh, "LED index: %d", app_settings_led_index());
    if (have) {
        shell_print(sh, "BME280:    T=%.2f C  RH=%.2f %%  P=%.2f kPa",
                    (double)r.temp_c, (double)r.humidity_pct, (double)r.pressure_kpa);
    } else {
        shell_print(sh, "BME280:    no reading yet");
    }
    return 0;
}

SHELL_STATIC_SUBCMD_SET_CREATE(sensorpouch_sub,
    SHELL_CMD(status, NULL, "Show pouch/BLE state, LED index, latest reading.", cmd_status),
    SHELL_SUBCMD_SET_END);
SHELL_CMD_REGISTER(sensorpouch, &sensorpouch_sub, "Phial sensor-pouch status", NULL);
```

## src/app_settings.c
```c
/* SPDX-License-Identifier: Apache-2.0 */
#include <zephyr/drivers/led.h>
#include <zephyr/logging/log.h>

#include <pouch/golioth/settings_callbacks.h>

#include "app_settings.h"
#include "led_index.h"

LOG_MODULE_REGISTER(app_settings, LOG_LEVEL_INF);

static const struct device *g_leds;
static int g_index;   /* 1-based; 0 = unset */

void app_settings_init(const struct device *leds)
{
    g_leds = leds;
}

int app_settings_led_index(void)
{
    return g_index;
}

/* Light LED `idx0` (0-based) and turn all others off. */
static void show_only(uint8_t idx0)
{
    if (g_leds == NULL) {
        return;
    }
    for (int i = 0; i < NUM_LEDS; i++) {
        if (i == idx0) {
            led_on(g_leds, i);
        } else {
            led_off(g_leds, i);
        }
    }
}

/* Golioth "LED" setting (int). 1..16 lights that LED; out-of-range is logged
 * and ignored (prior state kept). */
static int led_setting_cb(int32_t new_value)
{
    uint8_t idx0;

    if (!led_index_decode(new_value, &idx0)) {
        LOG_WRN("LED setting %d out of range 1..%d; ignoring", (int)new_value, NUM_LEDS);
        return 0;   /* accept the delivery; just don't act on a bad value */
    }
    LOG_INF("LED setting -> %d", (int)new_value);
    show_only(idx0);
    g_index = (int)new_value;
    return 0;
}

GOLIOTH_SETTINGS_HANDLER(LED, led_setting_cb);
```

## src/app_settings.h
```c
/* SPDX-License-Identifier: Apache-2.0 */
#ifndef PHIAL_APP_SETTINGS_H_
#define PHIAL_APP_SETTINGS_H_

#include <zephyr/device.h>

/* Give the settings module the LED device to drive. Call once at startup. */
void app_settings_init(const struct device *leds);

/* Current 1-based LED index (1..16), or 0 if none set yet. For `status`. */
int app_settings_led_index(void);

#endif /* PHIAL_APP_SETTINGS_H_ */
```

## src/env.c
```c
/* SPDX-License-Identifier: Apache-2.0 */

#include <zephyr/kernel.h>
#include <zephyr/device.h>
#include <zephyr/drivers/sensor.h>
#include <zephyr/logging/log.h>
#include <errno.h>

#include "env.h"

LOG_MODULE_REGISTER(env, LOG_LEVEL_INF);

#define ENV_SAMPLE_MS      10000
#define ENV_THREAD_STACK   1024
#define ENV_THREAD_PRIO    7

static const struct device *const bme = DEVICE_DT_GET(DT_NODELABEL(bme280));

static struct env_reading g_reading;     /* guarded by g_lock */
K_MUTEX_DEFINE(g_lock);

static void env_thread(void *p1, void *p2, void *p3);

/* SYS_FOREVER_MS start delay: the thread is NOT auto-started at boot
 * (K_THREAD_DEFINE's delay arg is a millisecond count; SYS_FOREVER_MS is the
 * sentinel for "never"). env_init() starts it only after the device-ready
 * check passes. */
K_THREAD_DEFINE(env_tid, ENV_THREAD_STACK, env_thread, NULL, NULL, NULL,
                ENV_THREAD_PRIO, 0, SYS_FOREVER_MS);

bool env_get(struct env_reading *out)
{
    bool valid;

    k_mutex_lock(&g_lock, K_FOREVER);
    *out = g_reading;
    valid = g_reading.valid;
    k_mutex_unlock(&g_lock);
    return valid;
}

static void env_thread(void *p1, void *p2, void *p3)
{
    ARG_UNUSED(p1); ARG_UNUSED(p2); ARG_UNUSED(p3);

    while (1) {
        struct sensor_value t, h, p;

        if (sensor_sample_fetch(bme) == 0 &&
            sensor_channel_get(bme, SENSOR_CHAN_AMBIENT_TEMP, &t) == 0 &&
            sensor_channel_get(bme, SENSOR_CHAN_HUMIDITY, &h) == 0 &&
            sensor_channel_get(bme, SENSOR_CHAN_PRESS, &p) == 0) {

            float temp = (float)sensor_value_to_double(&t);
            float hum  = (float)sensor_value_to_double(&h);
            float pres = (float)sensor_value_to_double(&p);

            k_mutex_lock(&g_lock, K_FOREVER);
            g_reading.temp_c       = temp;
            g_reading.humidity_pct = hum;
            g_reading.pressure_kpa = pres;
            g_reading.uptime_ms    = k_uptime_get();
            g_reading.valid        = true;
            k_mutex_unlock(&g_lock);

            LOG_INF("T=%.2f C  RH=%.2f %%  P=%.2f kPa",
                    (double)temp, (double)hum, (double)pres);
        } else {
            LOG_WRN("BME280 fetch failed");
        }

        k_msleep(ENV_SAMPLE_MS);
    }
}

int env_init(void)
{
    static bool started;

    if (started) {
        return 0;
    }
    if (!device_is_ready(bme)) {
        LOG_ERR("BME280 not ready");
        return -ENODEV;
    }
    k_thread_start(env_tid);
    started = true;
    return 0;
}
```

## src/led_index.c
```c
/* SPDX-License-Identifier: Apache-2.0 */
#include "led_index.h"

bool led_index_decode(int32_t setting_value, uint8_t *out_idx)
{
    if (setting_value < 1 || setting_value > NUM_LEDS) {
        return false;
    }
    *out_idx = (uint8_t)(setting_value - 1);
    return true;
}
```

## src/led_index.h
```c
/* SPDX-License-Identifier: Apache-2.0 */
#ifndef PHIAL_LED_INDEX_H_
#define PHIAL_LED_INDEX_H_

#include <stdbool.h>
#include <stdint.h>

#define NUM_LEDS 16

/* Decode a cloud "LED" setting value to a 0-based LED index. Returns true and
 * sets *out_idx for values 1..16; returns false (leaving *out_idx untouched)
 * for anything else. */
bool led_index_decode(int32_t setting_value, uint8_t *out_idx);

#endif /* PHIAL_LED_INDEX_H_ */
```
