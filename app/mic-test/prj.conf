## CMakeLists.txt
```
# SPDX-License-Identifier: Apache-2.0

cmake_minimum_required(VERSION 3.20.0)

# Pull in the shared shell/log Kconfig before find_package(Zephyr).
list(APPEND EXTRA_CONF_FILE "${CMAKE_CURRENT_LIST_DIR}/../../conf/shell-common.conf")

find_package(Zephyr REQUIRED HINTS $ENV{ZEPHYR_BASE})
project(mic_test)

target_sources(app PRIVATE
    src/main.c
    src/wav.c
    src/mic.c
    src/store.c
)
```

## sample.yaml
```
sample:
  name: Phial mic test
  description: Record from the MP34DT05 PDM mic while the boot button is held; store a WAV to flash.

common:
  build_only: true
  tags:
    - phial
    - mic
    - shell

tests:
  sample.phial.mic_test:
    platform_allow:
      - nrf54l15dk/nrf54l15/cpuapp
    integration_platforms:
      - nrf54l15dk/nrf54l15/cpuapp
```

## prj.conf
```kconfig
# Mic test app: record from the MP34DT05 PDM mic (pdm20) while the boot button
# is held; store the clip as a WAV to the mic_clip flash partition.
CONFIG_GPIO=y

# LED API + GPIO backend, for the 16-LED "recording" indicator. Unlike the DMIC
# and sensor drivers, the gpio-leds driver does NOT auto-enable from its DT node:
# its Kconfig is sourced only `if LED`, so CONFIG_LED must be set explicitly
# (same as led-test / sensor-test).
CONFIG_LED=y
CONFIG_LED_GPIO=y

# DMIC / PDM. The nrfx PDM driver (CONFIG_AUDIO_DMIC_NRFX_PDM) auto-enables from
# the enabled pdm20 devicetree node, so it is NOT listed here.
CONFIG_AUDIO=y
CONFIG_AUDIO_DMIC=y

# Flash map API for writing the WAV clip to the mic_clip partition.
CONFIG_FLASH=y
CONFIG_FLASH_MAP=y

# store_save_wav() runs on the main thread and descends into the RRAM flash
# driver with ~300 B of buffers on the stack — the deepest main-thread path
# here. Bump the main stack off the 1 KB default (matches led-test/sensor-test).
CONFIG_MAIN_STACK_SIZE=2048

# This app does not enable CONFIG_SENSOR, so the shared LIS2DH node in
# phial-common.dtsi is inert here. The BME280 driver is `default y` whenever its
# node is present, so disable it explicitly to keep it out of this audio app.
CONFIG_BME280=n

# Bringup diagnostic: Segger RTT as console + interactive shell, mirrors the
# sibling apps. shell-common.conf enables CONFIG_SHELL_BACKEND_SERIAL +
# CONFIG_SHELL_LOG_BACKEND, so logs route via the shell. Do NOT enable
# CONFIG_LOG_BACKEND_RTT (fights the shell over RTT channel 0) or a separate
# CONFIG_LOG_BACKEND_UART (would double-log on the UART).
CONFIG_USE_SEGGER_RTT=y
CONFIG_RTT_CONSOLE=y
CONFIG_SHELL_BACKEND_RTT=y
CONFIG_UART_CONSOLE=y
```

## src/main.c
```c
/* SPDX-License-Identifier: Apache-2.0 */

#include <zephyr/kernel.h>
#include <zephyr/device.h>
#include <zephyr/drivers/gpio.h>
#include <zephyr/drivers/led.h>
#include <zephyr/logging/log.h>

#include "mic.h"
#include "store.h"

LOG_MODULE_REGISTER(main, LOG_LEVEL_INF);

#define NUM_LEDS  16
#define POLL_MS   10

static const struct gpio_dt_spec button =
    GPIO_DT_SPEC_GET(DT_PATH(zephyr_user), button_gpios);

/* 128 KB capture buffer in .noinit: not zero-initialized at boot and not part of
 * the image's initialized data — it is fully overwritten by each capture. */
static int16_t cap_buf[MIC_MAX_SAMPLES] __noinit;

static bool button_pressed(void)
{
    /* GPIO_ACTIVE_LOW in DT -> logical 1 when the button is held. <0 on error
     * is treated as "not pressed". */
    return gpio_pin_get_dt(&button) == 1;
}

static void leds_all(const struct device *leds, bool on)
{
    for (int i = 0; i < NUM_LEDS; i++) {
        if (on) {
            led_on(leds, i);
        } else {
            led_off(leds, i);
        }
    }
}

int main(void)
{
    const struct device *leds = DEVICE_DT_GET_ANY(gpio_leds);
    bool mic_ok = false;

    if (leds == NULL || !device_is_ready(leds)) {
        LOG_ERR("LED device not ready");
        return -ENODEV;
    }
    if (!gpio_is_ready_dt(&button) ||
        gpio_pin_configure_dt(&button, GPIO_INPUT | GPIO_PULL_UP) != 0) {
        LOG_ERR("boot button GPIO not ready");
        return -ENODEV;
    }

    mic_ok = (mic_init() == 0);
    if (!mic_ok) {
        LOG_WRN("mic disabled (PDM unavailable); button/LEDs still work");
    }

    leds_all(leds, false);
    LOG_INF("Phial mic-test: hold the boot button to record (max %u ms); "
            "release to store. 'mic info' to retrieve.",
            (unsigned)(MIC_MAX_SAMPLES * 1000U / MIC_SAMPLE_RATE));

    while (1) {
        if (!button_pressed()) {
            k_msleep(POLL_MS);
            continue;
        }

        /* Press: light the board and record until release or buffer full. */
        leds_all(leds, true);
        LOG_INF("recording...");

        size_t n = 0;

        if (mic_ok) {
            int rc = mic_capture(cap_buf, MIC_MAX_SAMPLES, button_pressed, &n);

            if (rc < 0) {
                LOG_WRN("capture error (%d); %zu samples salvaged", rc, n);
            } else if (n == MIC_MAX_SAMPLES) {
                LOG_INF("max length reached");
            }
        } else {
            /* No mic: hold the LEDs while pressed so the button still demos. */
            while (button_pressed()) {
                k_msleep(POLL_MS);
            }
        }

        leds_all(leds, false);

        if (n > 0) {
            int rc = store_save_wav(cap_buf, n, MIC_SAMPLE_RATE);

            if (rc < 0) {
                LOG_ERR("store failed (%d)", rc);
            } else {
                struct clip_info c;

                store_last(&c);
                LOG_INF("stored %u bytes @ 0x%06x (%u samples, %u ms) — "
                        "'mic info' for the readback command",
                        c.len, c.addr, c.samples,
                        c.samples * 1000U / MIC_SAMPLE_RATE);
            }
        } else if (mic_ok) {
            LOG_INF("nothing captured");
        }
    }
    return 0;
}
```

## src/mic.c
```c
/* SPDX-License-Identifier: Apache-2.0 */

#include <zephyr/kernel.h>
#include <zephyr/device.h>
#include <zephyr/audio/dmic.h>
#include <zephyr/logging/log.h>
#include <string.h>

#include "mic.h"

LOG_MODULE_REGISTER(mic, LOG_LEVEL_INF);

#define PDM_NODE        DT_NODELABEL(pdm20)

/* ~10 ms PCM block. keep_going() is polled once per block, so worst-case stop
 * latency is one block period plus READ_TIMEOUT_MS (~210 ms) — fine for a
 * hand-held button. Small blocks keep DMA churn low. */
#define BLOCK_MS        10U
#define BLOCK_SAMPLES   (MIC_SAMPLE_RATE * BLOCK_MS / 1000U)   /* 160 */
#define BLOCK_BYTES     (BLOCK_SAMPLES * sizeof(int16_t))            /* 320 */
#define BLOCK_COUNT     8U
#define READ_TIMEOUT_MS 200

/* Driver-owned slab the PDM DMA fills; we copy out and free each block. */
K_MEM_SLAB_DEFINE_STATIC(mic_slab, BLOCK_BYTES, BLOCK_COUNT, 4);

static const struct device *const mic_dev = DEVICE_DT_GET(PDM_NODE);
static bool init_ok;

int mic_init(void)
{
    if (!device_is_ready(mic_dev)) {
        LOG_ERR("PDM device (pdm20) not ready");
        return -ENODEV;
    }

    struct pcm_stream_cfg stream = {
        .pcm_width = 16,
        .pcm_rate  = MIC_SAMPLE_RATE,
        .block_size = BLOCK_BYTES,
        .mem_slab  = &mic_slab,
    };
    struct dmic_cfg cfg = {
        .io = {
            /* Allow the PDM clock range that yields ~16 kHz (1.024 MHz) — the
             * MP34DT05 normal mode. */
            .min_pdm_clk_freq = 1000000,
            .max_pdm_clk_freq = 3250000,
            .min_pdm_clk_dc   = 40,
            .max_pdm_clk_dc   = 60,
        },
        .streams = &stream,
        .channel = {
            .req_num_streams = 1,
            .req_num_chan    = 1,
            .req_chan_map_lo = dmic_build_channel_map(0, 0, PDM_CHAN_LEFT),
        },
    };

    int rc = dmic_configure(mic_dev, &cfg);
    if (rc < 0) {
        LOG_ERR("dmic_configure failed (%d)", rc);
        return rc;
    }

    init_ok = true;
    return 0;
}

int mic_capture(int16_t *buf, size_t max_samples,
                bool (*keep_going)(void), size_t *out_samples)
{
    size_t got = 0;
    int rc = 0;

    *out_samples = 0;
    if (!init_ok) {
        return -ENODEV;
    }

    rc = dmic_trigger(mic_dev, DMIC_TRIGGER_START);
    if (rc < 0) {
        LOG_ERR("DMIC START failed (%d)", rc);
        return rc;
    }

    while (got < max_samples && keep_going()) {
        void *blk;
        size_t size;

        rc = dmic_read(mic_dev, 0, &blk, &size, READ_TIMEOUT_MS);
        if (rc < 0) {
            LOG_WRN("dmic_read failed (%d); stopping with %zu samples", rc, got);
            break;
        }

        size_t avail = size / sizeof(int16_t);
        size_t room  = max_samples - got;
        size_t take  = avail < room ? avail : room;

        memcpy(&buf[got], blk, take * sizeof(int16_t));
        got += take;
        k_mem_slab_free(&mic_slab, blk);
    }

    int stop_rc = dmic_trigger(mic_dev, DMIC_TRIGGER_STOP);
    if (stop_rc < 0) {
        LOG_WRN("DMIC STOP failed (%d)", stop_rc);
    }

    *out_samples = got;
    /* A clean stop (keep_going false / buffer full) is success; only a read
     * error propagates as failure. */
    return (rc < 0) ? rc : 0;
}
```

## src/mic.h
```c
/* SPDX-License-Identifier: Apache-2.0 */
#ifndef PHIAL_MIC_H_
#define PHIAL_MIC_H_

#include <stdbool.h>
#include <stddef.h>
#include <stdint.h>

/* PCM format the mic captures. 16 kHz / 16-bit / mono. The PDM driver lands on
 * the closest achievable rate (<1 % from 16000) and does not report it back, so
 * MIC_SAMPLE_RATE is what we record AND what we stamp into the WAV header. */
#define MIC_SAMPLE_RATE 16000U

/* Configure the pdm20 PDM peripheral. Returns 0 on success, <0 on failure
 * (device not ready / configure error). */
int mic_init(void);

/* Capture up to `max_samples` 16-bit mono samples into `buf` (blocking). Polls
 * keep_going() once per DMIC block and stops when it returns false or the buffer
 * is full (worst-case stop latency ~one block + the read timeout, a few hundred
 * ms). On return *out_samples holds the number of samples captured.
 * Returns 0 on success (incl. a clean stop), <0 on a DMIC error (whatever was
 * captured so far is still reported in *out_samples). */
int mic_capture(int16_t *buf, size_t max_samples,
                bool (*keep_going)(void), size_t *out_samples);

#endif /* PHIAL_MIC_H_ */
```

## src/store.c
```c
/* SPDX-License-Identifier: Apache-2.0 */

#include <zephyr/kernel.h>
#include <zephyr/storage/flash_map.h>
#include <zephyr/shell/shell.h>
#include <zephyr/logging/log.h>
#include <string.h>

#include "store.h"
#include "wav.h"

LOG_MODULE_REGISTER(store, LOG_LEVEL_INF);

#define FA_ID            FIXED_PARTITION_ID(MIC_CLIP_PARTITION)
#define ERASE_BLOCK      4096U     /* RRAM erase-block-size */
#define WRITE_ALIGN      16U       /* RRAM write-block-size */
#define CHUNK            256U      /* staging chunk; multiple of WRITE_ALIGN */

static struct clip_info last;

static uint32_t align_up(uint32_t v, uint32_t a)
{
    return (v + a - 1U) & ~(a - 1U);
}

int store_save_wav(const int16_t *pcm, size_t samples, uint32_t rate)
{
    const struct flash_area *fa;
    uint8_t hdr[WAV_HEADER_BYTES];
    uint8_t chunk[CHUNK];
    int rc;

    const uint32_t pcm_bytes = (uint32_t)samples * 2U;
    const uint32_t total     = WAV_HEADER_BYTES + pcm_bytes;     /* logical len */
    const uint32_t padded    = align_up(total, WRITE_ALIGN);     /* write size  */
    const uint32_t erased    = align_up(padded, ERASE_BLOCK);    /* erase size  */

    if (padded > MIC_CLIP_SIZE) {
        LOG_ERR("clip too large: %u > %u", padded, (uint32_t)MIC_CLIP_SIZE);
        return -ENOSPC;
    }

    rc = flash_area_open(FA_ID, &fa);
    if (rc < 0) {
        LOG_ERR("flash_area_open failed (%d)", rc);
        return rc;
    }

    rc = flash_area_erase(fa, 0, erased);
    if (rc < 0) {
        LOG_ERR("flash_area_erase failed (%d)", rc);
        goto out;
    }

    wav_header(hdr, (uint32_t)samples, rate);

    /* Stream header+PCM as one logical byte run, written in CHUNK-sized,
     * 16-byte-aligned pieces. The last chunk is zero-padded to WRITE_ALIGN. */
    for (uint32_t off = 0; off < padded; off += CHUNK) {
        uint32_t n = (padded - off < CHUNK) ? (padded - off) : CHUNK;

        for (uint32_t i = 0; i < n; i++) {
            uint32_t pos = off + i;        /* byte index into the logical WAV */

            if (pos < WAV_HEADER_BYTES) {
                chunk[i] = hdr[pos];
            } else if (pos < total) {
                chunk[i] = ((const uint8_t *)pcm)[pos - WAV_HEADER_BYTES];
            } else {
                chunk[i] = 0;              /* alignment padding */
            }
        }

        rc = flash_area_write(fa, off, chunk, n);
        if (rc < 0) {
            LOG_ERR("flash_area_write @%u failed (%d)", off, rc);
            goto out;
        }
    }

    /* Publish as one compound-literal store so the shell thread (which reads
     * `last` via store_last) can't observe valid=true alongside stale fields. */
    last = (struct clip_info){
        .addr    = (uint32_t)fa->fa_off,   /* absolute RRAM address */
        .len     = total,
        .samples = (uint32_t)samples,
        .rate    = rate,
        .valid   = true,
    };
    rc = 0;

out:
    flash_area_close(fa);
    return rc;
}

void store_last(struct clip_info *out)
{
    *out = last;
}

int store_erase(void)
{
    const struct flash_area *fa;
    int rc = flash_area_open(FA_ID, &fa);

    if (rc < 0) {
        return rc;
    }
    rc = flash_area_erase(fa, 0, MIC_CLIP_SIZE);
    flash_area_close(fa);
    if (rc == 0) {
        memset(&last, 0, sizeof(last));
    }
    return rc;
}

/* ---- mic shell command -------------------------------------------------- */

static int cmd_mic_info(const struct shell *sh, size_t argc, char **argv)
{
    ARG_UNUSED(argc); ARG_UNUSED(argv);
    struct clip_info c;

    store_last(&c);
    if (!c.valid) {
        shell_print(sh, "no clip stored yet (hold the boot button to record)");
        return 0;
    }
    shell_print(sh, "clip: %u bytes WAV @ 0x%06x  (%u samples, %u Hz, %u ms)",
                c.len, c.addr, c.samples, c.rate,
                (c.rate ? (c.samples * 1000U / c.rate) : 0U));
    shell_print(sh, "read off (binary) in a J-Link session:  savebin rec.wav 0x%06x %u",
                c.addr, c.len);
    shell_print(sh, "(savebin writes raw bytes = a playable .wav; an nrfjprog "
                    "--memrd dump is hex text, not a WAV)");
    return 0;
}

static int cmd_mic_erase(const struct shell *sh, size_t argc, char **argv)
{
    ARG_UNUSED(argc); ARG_UNUSED(argv);
    int rc = store_erase();

    if (rc < 0) {
        shell_error(sh, "erase failed (%d)", rc);
        return rc;
    }
    shell_print(sh, "mic_clip erased");
    return 0;
}

SHELL_STATIC_SUBCMD_SET_CREATE(mic_sub,
    SHELL_CMD(info,  NULL, "Show the last stored clip + readback command.", cmd_mic_info),
    SHELL_CMD(erase, NULL, "Erase the stored clip.", cmd_mic_erase),
    SHELL_SUBCMD_SET_END);

SHELL_CMD_REGISTER(mic, &mic_sub, "Phial mic clip storage", NULL);
```

## src/store.h
```c
/* SPDX-License-Identifier: Apache-2.0 */
#ifndef PHIAL_STORE_H_
#define PHIAL_STORE_H_

#include <stdbool.h>
#include <stddef.h>
#include <stdint.h>

#include <zephyr/storage/flash_map.h>

#include "wav.h"   /* WAV_HEADER_BYTES */

/* The mic_clip partition. */
#define MIC_CLIP_PARTITION   mic_clip_partition
#define MIC_CLIP_SIZE        FIXED_PARTITION_SIZE(MIC_CLIP_PARTITION)

/* Largest clip (in samples) whose WAV (header + 16-bit-mono PCM) fits the
 * partition. Rounded down to a multiple of 8 samples so the PCM byte count is a
 * multiple of the 16-byte flash write block. */
#define MIC_MAX_SAMPLES      ((((MIC_CLIP_SIZE) - WAV_HEADER_BYTES) / 2U) & ~7U)

struct clip_info {
    uint32_t addr;     /* absolute flash address of the WAV (partition base) */
    uint32_t len;      /* total bytes written (44 header + PCM, pre-padding)  */
    uint32_t samples;  /* PCM sample count                                    */
    uint32_t rate;     /* sample rate stamped in the WAV header               */
    bool     valid;    /* false until a successful save                       */
};

/* Write a WAV (header + `samples` 16-bit PCM samples from `pcm`) to the mic_clip
 * partition in one pass. Returns 0 on success, <0 on a flash error. */
int  store_save_wav(const int16_t *pcm, size_t samples, uint32_t rate);

/* Copy the last successfully stored clip's info (or .valid = false). */
void store_last(struct clip_info *out);

/* Erase the partition and clear the stored clip info. Returns 0 / <0. */
int  store_erase(void);

#endif /* PHIAL_STORE_H_ */
```

## src/wav.c
```c
/* SPDX-License-Identifier: Apache-2.0 */

#include "wav.h"

/* Little-endian stores — the WAV format is little-endian regardless of host. */
static void put_u16(uint8_t *p, uint16_t v)
{
    p[0] = (uint8_t)(v & 0xff);
    p[1] = (uint8_t)((v >> 8) & 0xff);
}

static void put_u32(uint8_t *p, uint32_t v)
{
    p[0] = (uint8_t)(v & 0xff);
    p[1] = (uint8_t)((v >> 8) & 0xff);
    p[2] = (uint8_t)((v >> 16) & 0xff);
    p[3] = (uint8_t)((v >> 24) & 0xff);
}

static void put_tag(uint8_t *p, const char *tag)
{
    p[0] = (uint8_t)tag[0];
    p[1] = (uint8_t)tag[1];
    p[2] = (uint8_t)tag[2];
    p[3] = (uint8_t)tag[3];
}

void wav_header(uint8_t hdr[WAV_HEADER_BYTES], uint32_t samples, uint32_t rate)
{
    const uint32_t data_bytes = samples * 2U;   /* 16-bit mono: 2 bytes/sample */

    put_tag(&hdr[0],  "RIFF");
    put_u32(&hdr[4],  36U + data_bytes);
    put_tag(&hdr[8],  "WAVE");
    put_tag(&hdr[12], "fmt ");
    put_u32(&hdr[16], 16U);            /* PCM fmt chunk size */
    put_u16(&hdr[20], 1U);             /* audio format = PCM */
    put_u16(&hdr[22], 1U);             /* channels = mono */
    put_u32(&hdr[24], rate);
    put_u32(&hdr[28], rate * 2U);      /* byte rate = rate * blockalign */
    put_u16(&hdr[32], 2U);             /* block align = channels * 2 */
    put_u16(&hdr[34], 16U);            /* bits per sample */
    put_tag(&hdr[36], "data");
    put_u32(&hdr[40], data_bytes);
}
```

## src/wav.h
```c
/* SPDX-License-Identifier: Apache-2.0 */
#ifndef PHIAL_WAV_H_
#define PHIAL_WAV_H_

#include <stdint.h>

/* Number of bytes a canonical PCM WAV header occupies. */
#define WAV_HEADER_BYTES 44

/* Fill `hdr` with a 44-byte little-endian canonical PCM WAV/RIFF header for a
 * 16-bit, mono stream of `samples` samples at `rate` Hz. Writes exactly
 * WAV_HEADER_BYTES bytes. Pure function — no hardware, no allocation. */
void wav_header(uint8_t hdr[WAV_HEADER_BYTES], uint32_t samples, uint32_t rate);

#endif /* PHIAL_WAV_H_ */
```
