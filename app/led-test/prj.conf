## CMakeLists.txt
```
# SPDX-License-Identifier: Apache-2.0

cmake_minimum_required(VERSION 3.20.0)

# Pull in the shared shell/log Kconfig before find_package(Zephyr).
list(APPEND EXTRA_CONF_FILE "${CMAKE_CURRENT_LIST_DIR}/../../conf/shell-common.conf")

find_package(Zephyr REQUIRED HINTS $ENV{ZEPHYR_BASE})
project(led_test)

target_sources(app PRIVATE
    src/main.c
)
```

## sample.yaml
```
sample:
  name: Phial LED test
  description: Drive 16 GPIO LEDs with patterns; exercise Zephyr shell.

common:
  build_only: true
  tags:
    - phial
    - led
    - shell

tests:
  sample.phial.led_test:
    platform_allow:
      - nrf54l15dk/nrf54l15/cpuapp
    integration_platforms:
      - nrf54l15dk/nrf54l15/cpuapp
```

## prj.conf
```kconfig
# LED API + GPIO backend (Phase 1)
CONFIG_LED=y
CONFIG_LED_GPIO=y

# Subsystems used by the app
CONFIG_GPIO=y
CONFIG_I2C=y                    # not used by code yet, but the bus must be
                                # available so `i2c scan` in the shell works.

# Slightly larger main stack — animation thread + shell + log
CONFIG_MAIN_STACK_SIZE=2048

# Bringup diagnostic: Segger RTT as console + interactive shell.
# RTT runs over SWD so it works even if UART pinctrl is wrong for this board.
# Open with `JLinkRTTViewer` (Segger) or `nrfutil device rtt` after `west flash`.
CONFIG_USE_SEGGER_RTT=y
CONFIG_RTT_CONSOLE=y
# Shell over RTT.  shell-common.conf already enables
# CONFIG_SHELL_LOG_BACKEND=y, so log messages route via the shell to RTT
# (and also harmlessly to the dead UART). Do NOT also enable
# CONFIG_LOG_BACKEND_RTT — it'd fight the shell over RTT channel 0.
CONFIG_SHELL_BACKEND_RTT=y

# UART console: now that pinctrl is routed to the Phial debug-header
# pins (P1.08 TX / P1.07 RX via Tag-Connect J103), the shell is also
# available over serial UART.  shell-common.conf already enables
# CONFIG_SHELL_BACKEND_SERIAL=y; its shell log backend carries UART logs,
# so we deliberately do NOT enable a separate CONFIG_LOG_BACKEND_UART.
CONFIG_UART_CONSOLE=y

# Note: the shared boards/phial-common.dtsi defines sensor nodes (bme280@76,
# lis2dh12@18), but led-test does not enable CONFIG_SENSOR, so no sensor driver
# Kconfigs are sourced and no sensor driver is compiled in — the nodes are inert
# here. (Enabling CONFIG_SENSOR would auto-enable those drivers from the DT
# nodes alone; no per-driver CONFIG_* needed.)

# (Phase 2 will add):   CONFIG_LED_PWM=y / CONFIG_PWM=y
# (Phase 3 BLE adds):   CONFIG_BT=y / CONFIG_BT_PERIPHERAL=y / CONFIG_BT_SHELL=y
# (Phase 4 Pouch adds): CONFIG_GOLIOTH_*=y / CONFIG_BOOTLOADER_MCUBOOT=y
```

## boards/nrf54l15dk_nrf54l15_cpuapp.overlay
```dts
/*
 * Per-app overlay wrapper: pull in the shared Phial hardware description.
 * Add app-specific tweaks below the include if ever needed; otherwise leave alone.
 */

#include "../../../boards/phial-common.dtsi"
```

## src/main.c
```c
/* SPDX-License-Identifier: Apache-2.0 */

#include <zephyr/kernel.h>
#include <zephyr/device.h>
#include <zephyr/drivers/led.h>
#include <zephyr/logging/log.h>

LOG_MODULE_REGISTER(main, LOG_LEVEL_INF);

#define NUM_LEDS      16
#define OUTER_LEDS    12
#define DWELL_MS      30
#define CROSSOVER_MS  20

/* Index → expected Phial label + nRF pin, for cross-checking against the PCB.
 * Order must match the children of `leds {}` in boards/phial-common.dtsi. */
static const char *const led_names[NUM_LEDS] = {
    "LED01 P1.10",
    "LED02 P1.09",
    "LED03 P0.03",
    "LED04 P0.02",
    "LED05 P2.06",
    "LED06 P2.05",
    "LED07 P2.04",
    "LED08 P2.03",
    "LED09 P2.02",
    "LED10 P2.01",
    "LED11 P2.00",
    "LED12 P1.14",
    "LED13 P2.08",
    "LED14 P2.09",
    "LED15 P2.10",
    "LED16 P2.07",
};

/* Maps each outer LED (0-11, clock-face) to the inner cardinal LED (12-15)
 * that sits closest to that quadrant:
 *   north (12): LEDs 11, 12, 1  → indices 10, 11, 0
 *   east  (13): LEDs  2,  3, 4  → indices  1,  2, 3
 *   south (14): LEDs  5,  6, 7  → indices  4,  5, 6
 *   west  (15): LEDs  8,  9, 10 → indices  7,  8, 9 */
static const uint8_t inner_for_outer[OUTER_LEDS] = {
    12, /* idx  0 = LED01 → LED13 north */
    13, /* idx  1 = LED02 → LED14 east  */
    13, /* idx  2 = LED03 → LED14 east  */
    13, /* idx  3 = LED04 → LED14 east  */
    14, /* idx  4 = LED05 → LED15 south */
    14, /* idx  5 = LED06 → LED15 south */
    14, /* idx  6 = LED07 → LED15 south */
    15, /* idx  7 = LED08 → LED16 west  */
    15, /* idx  8 = LED09 → LED16 west  */
    15, /* idx  9 = LED10 → LED16 west  */
    12, /* idx 10 = LED11 → LED13 north */
    12, /* idx 11 = LED12 → LED13 north */
};

int main(void)
{
    const struct device *leds = DEVICE_DT_GET_ANY(gpio_leds);

    if (leds == NULL || !device_is_ready(leds)) {
        LOG_ERR("LED device not ready");
        return -ENODEV;
    }

    LOG_INF("Phial LED walk: %d outer + 4 inner, %d ms dwell, %d ms crossover",
            OUTER_LEDS, DWELL_MS, CROSSOVER_MS);

    for (int i = 0; i < NUM_LEDS; i++) {
        led_off(leds, i);
    }

    while (1) {
        for (int i = 0; i < OUTER_LEDS; i++) {
            int next_outer = (i + 1) % OUTER_LEDS;
            int cur_inner  = inner_for_outer[i];
            int next_inner = inner_for_outer[next_outer];

            //LOG_INF("idx=%d -> %s ON", i, led_names[i]);
            led_on(leds, i);
            led_on(leds, cur_inner);
            k_msleep(DWELL_MS - CROSSOVER_MS);

            /* crossover: light next outer; if quadrant boundary, next inner too */
            led_on(leds, next_outer);
            if (next_inner != cur_inner) {
                led_on(leds, next_inner);
            }
            k_msleep(CROSSOVER_MS);

            led_off(leds, i);
            if (next_inner != cur_inner) {
                led_off(leds, cur_inner);
            }
        }
    }

    return 0;
}
```
