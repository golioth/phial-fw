## CMakeLists.txt
```
# SPDX-License-Identifier: Apache-2.0

cmake_minimum_required(VERSION 3.20.0)

# Pull in the shared shell/log Kconfig before find_package(Zephyr).
list(APPEND EXTRA_CONF_FILE "${CMAKE_CURRENT_LIST_DIR}/../../conf/shell-common.conf")

find_package(Zephyr REQUIRED HINTS $ENV{ZEPHYR_BASE})
project(buzzer_test)

target_sources(app PRIVATE
    src/main.c
    src/buzzer.c
)
```

## sample.yaml
```
sample:
  name: Phial buzzer test
  description: Play GPIO square-wave test tones on the P0.04 buzzer via the shell.

common:
  build_only: true
  tags:
    - phial
    - buzzer
    - shell

tests:
  sample.phial.buzzer_test:
    platform_allow:
      - nrf54l15dk/nrf54l15/cpuapp
    integration_platforms:
      - nrf54l15dk/nrf54l15/cpuapp
```

## prj.conf
```kconfig
# Buzzer test app: GPIO square-wave tones on P0.04 via the shell.
CONFIG_GPIO=y

# Bringup diagnostic: Segger RTT as console + interactive shell, mirrors led-test.
# RTT runs over SWD so it works even if UART pinctrl is wrong for this board.
CONFIG_USE_SEGGER_RTT=y
CONFIG_RTT_CONSOLE=y
# Shell over RTT. shell-common.conf enables CONFIG_SHELL_BACKEND_SERIAL +
# CONFIG_SHELL_LOG_BACKEND, so logs route via the shell. Do NOT enable
# CONFIG_LOG_BACKEND_RTT (fights the shell over RTT channel 0) or a separate
# CONFIG_LOG_BACKEND_UART (would double-log on the UART).
CONFIG_SHELL_BACKEND_RTT=y
CONFIG_UART_CONSOLE=y

# This app does not enable CONFIG_SENSOR, so the shared BME280/LIS2DH nodes in
# phial-common.dtsi are inert here (their driver Kconfigs are sourced only under
# `if SENSOR`) — no sensor drivers are compiled in.
```

## src/main.c
```c
/* SPDX-License-Identifier: Apache-2.0 */

#include <zephyr/kernel.h>
#include <zephyr/logging/log.h>

#include "buzzer.h"

LOG_MODULE_REGISTER(main, LOG_LEVEL_INF);

int main(void)
{
    if (buzzer_init() != 0) {
        LOG_WRN("buzzer disabled (GPIO unavailable)");
    }
    LOG_INF("Phial buzzer-test: try 'buzzer sweep' or 'buzzer tone <hz> [ms]'");
    return 0;
}
```

## src/buzzer.c
```c
/* SPDX-License-Identifier: Apache-2.0 */

#include <zephyr/kernel.h>
#include <zephyr/drivers/gpio.h>
#include <zephyr/logging/log.h>
#include <zephyr/shell/shell.h>
#include <errno.h>
#include <stdlib.h>

#include "buzzer.h"

LOG_MODULE_REGISTER(buzzer, LOG_LEVEL_INF);

#define TONE_MS_DEFAULT  250
#define SWEEP_GAP_MS     100
#define FREQ_MAX_HZ      20000

static const struct gpio_dt_spec buzzer =
    GPIO_DT_SPEC_GET(DT_PATH(zephyr_user), buzzer_gpios);

static bool init_ok;   /* true only after the pin is configured as output */

/* Half-octave (x sqrt(2)) series, 800 Hz up to an 8000 Hz ceiling. */
static const uint32_t sweep_hz[] = {
    800, 1131, 1600, 2263, 3200, 4525, 6400, 8000,
};

int buzzer_init(void)
{
    int rc;

    if (!gpio_is_ready_dt(&buzzer)) {
        LOG_ERR("buzzer GPIO not ready");
        return -ENODEV;
    }
    rc = gpio_pin_configure_dt(&buzzer, GPIO_OUTPUT_INACTIVE);
    if (rc != 0) {
        LOG_ERR("buzzer GPIO configure failed (%d)", rc);
        return rc;
    }
    init_ok = true;
    return 0;
}

void buzzer_tone(uint32_t hz, uint32_t ms)
{
    uint32_t half_us, toggles;

    if (!init_ok || hz == 0 || ms == 0) {
        return;
    }

    half_us = 1000000U / (2U * hz);
    if (half_us == 0) {
        return;                       /* frequency too high to represent */
    }
    toggles = (uint32_t)((uint64_t)ms * 1000U / half_us);

    for (uint32_t i = 0; i < toggles; i++) {
        gpio_pin_toggle_dt(&buzzer);
        k_busy_wait(half_us);
    }
    gpio_pin_set_dt(&buzzer, 0);      /* idle LOW regardless of toggle parity */
}

void buzzer_sweep(void)
{
    for (size_t i = 0; i < ARRAY_SIZE(sweep_hz); i++) {
        LOG_INF("buzzer: %u Hz", sweep_hz[i]);
        buzzer_tone(sweep_hz[i], TONE_MS_DEFAULT);
        k_msleep(SWEEP_GAP_MS);
    }
}

/* ---- buzzer shell command ---------------------------------------------- */

static int cmd_buzzer_sweep(const struct shell *sh, size_t argc, char **argv)
{
    ARG_UNUSED(argc); ARG_UNUSED(argv);

    if (!init_ok) {
        shell_error(sh, "buzzer unavailable");
        return -ENODEV;
    }
    shell_print(sh, "sweeping 800..8000 Hz");
    buzzer_sweep();
    return 0;
}

static int cmd_buzzer_tone(const struct shell *sh, size_t argc, char **argv)
{
    long hz, ms;

    if (!init_ok) {
        shell_error(sh, "buzzer unavailable");
        return -ENODEV;
    }
    hz = strtol(argv[1], NULL, 10);
    ms = (argc > 2) ? strtol(argv[2], NULL, 10) : TONE_MS_DEFAULT;

    if (hz <= 0 || hz > FREQ_MAX_HZ) {
        shell_error(sh, "hz must be 1..%d", FREQ_MAX_HZ);
        return -EINVAL;
    }
    if (ms <= 0) {
        shell_error(sh, "ms must be > 0");
        return -EINVAL;
    }
    shell_print(sh, "tone %ld Hz for %ld ms", hz, ms);
    buzzer_tone((uint32_t)hz, (uint32_t)ms);
    return 0;
}

SHELL_STATIC_SUBCMD_SET_CREATE(buzzer_sub,
    SHELL_CMD(sweep, NULL, "Play the 800..8000 Hz half-octave sweep.",
              cmd_buzzer_sweep),
    SHELL_CMD_ARG(tone, NULL, "Play <hz> [ms] (default 250 ms).",
                  cmd_buzzer_tone, 2, 1),
    SHELL_SUBCMD_SET_END);

SHELL_CMD_REGISTER(buzzer, &buzzer_sub, "Phial buzzer test tones", NULL);
```

## src/buzzer.h
```c
/* SPDX-License-Identifier: Apache-2.0 */
#ifndef PHIAL_BUZZER_H_
#define PHIAL_BUZZER_H_

#include <stdint.h>

/* Configure the buzzer GPIO (P0.04) as an output, idle LOW.
 * Returns 0 on success, -ENODEV if the GPIO is not ready. */
int buzzer_init(void);

/* Play a square-wave tone at `hz` for `ms` milliseconds (blocking).
 * No-op when hz == 0 or before a successful buzzer_init(). The pin is left
 * LOW afterward. */
void buzzer_tone(uint32_t hz, uint32_t ms);

/* Play the fixed half-octave sweep (800..8000 Hz), blocking. */
void buzzer_sweep(void);

#endif /* PHIAL_BUZZER_H_ */
```
